## rt-thread-v4.1.0_BSP_stm32L475/bsp/stm32/stm32l475-rtt-pandora - 副本/board/Kconfig
```kconfig
menu "Hardware Drivers Config"

	config SOC_STM32L475VE
		bool
		select SOC_SERIES_STM32L4
		select RT_USING_COMPONENTS_INIT
		select RT_USING_USER_MAIN
		default y

menu "Onboard Peripheral Drivers"

	menuconfig BSP_USING_I2C
        bool "Enable I2C BUS"
        default n
        select RT_USING_I2C
        select RT_USING_I2C_BITOPS
        select RT_USING_PIN
        if BSP_USING_I2C
            menuconfig BSP_USING_I2C4
                bool "Enable I2C4 BUS (AHT10)"
                default n
                if BSP_USING_I2C4
                    comment "Notice: PC1 --> 33; PD6 --> 54" 
                    config BSP_I2C4_SCL_PIN
                        int "i2c4 scl pin number"
                        range 1 176
                        default 54
                    config BSP_I2C4_SDA_PIN
                        int "I2C4 sda pin number"
                        range 1 176
                        default 33
                endif
        endif
	
	config BSP_USING_AHT10
        bool "Enable aht10 (i2c4)"
        select BSP_USING_I2C
        select BSP_USING_I2C4
        select PKG_USING_SENSORS_DRIVERS
        select PKG_USING_AHT10
        select PKG_USING_AHT10_LATEST_VERSION
        default n

	config BSP_USING_KEY
			bool "Enable onboard keys"
			select RT_USING_PIN
			select RT_USING_TIMER_SOFT
			select PKG_USING_FLEXIBLE_BUTTON
			default n
			
	config BSP_USING_SPI_LCD
        bool "Enable LCD (spi3)"
        select BSP_USING_SPI
        select BSP_USING_SPI3
        select BSP_SPI3_TX_USING_DMA
        select BSP_USING_PWM
        select BSP_USING_PWM4
        select BSP_USING_PWM4_CH2
        default n

    config BSP_USING_LCD_SAMPLE
        bool "Enable LCD raw driver sample"
        depends on BSP_USING_SPI_LCD
        default n

    config BSP_USING_LCD_QRCODE
        bool "Enable LCD to show QRCode"
        depends on BSP_USING_SPI_LCD
        select BSP_USING_LCD_SAMPLE
        select PKG_USING_QRCODE
        default n		

endmenu

menu "On-chip Peripheral Drivers"

	config BSP_USING_QSPI_FLASH
        bool "Enable QSPI FLASH (W25Q128 qspi1)"
        select BSP_USING_QSPI
        select RT_USING_SFUD
        select RT_SFUD_USING_QSPI
        default n
		
	config BSP_USING_QSPI
        bool "Enable QSPI BUS"
        select RT_USING_QSPI
        select RT_USING_SPI
        default n

    config BSP_QSPI_USING_DMA
        bool "Enable QSPI DMA support"
        default n
		
	menuconfig BSP_USING_PWM
        bool "Enable PWM"
        default n
        select RT_USING_PWM
        if BSP_USING_PWM

        menuconfig BSP_USING_PWM4
            bool "Enable timer4 output PWM"
            default n
            if BSP_USING_PWM4
                config BSP_USING_PWM4_CH1
                    bool "Enable PWM4 channel1"
                    default n

                config BSP_USING_PWM4_CH2
                    bool "Enable PWM4 channel2"
                    default n
            
                config BSP_USING_PWM4_CH3
                    bool "Enable PWM4 channel3"
                    default n

                config BSP_USING_PWM4_CH4
                    bool "Enable PWM4 channel4"
                    default n
            endif
        endif

	menuconfig BSP_USING_SPI
        bool "Enable SPI BUS"
        default n
        select RT_USING_SPI
        if BSP_USING_SPI
            config BSP_USING_SPI1
                bool "Enable SPI1 BUS"
                default n

            config BSP_SPI1_TX_USING_DMA
                bool "Enable SPI1 TX DMA"
                depends on BSP_USING_SPI1
                default n
                
            config BSP_SPI1_RX_USING_DMA
                bool "Enable SPI1 RX DMA"
                depends on BSP_USING_SPI1
                select BSP_SPI1_TX_USING_DMA
                default n
                
            config BSP_USING_SPI3
                bool "Enable SPI3 BUS"
                default n

            config BSP_SPI3_TX_USING_DMA
                bool "Enable SPI3 TX DMA"
                depends on BSP_USING_SPI3
                default n
                
            config BSP_SPI3_RX_USING_DMA
                bool "Enable SPI3 RX DMA"
                depends on BSP_USING_SPI3
                select BSP_SPI3_TX_USING_DMA
                default n
        endif


    config BSP_USING_GPIO
        bool "Enable GPIO"
        select RT_USING_PIN
        default y

    menuconfig BSP_USING_UART
        bool "Enable UART"
        default y
        select RT_USING_SERIAL
        if BSP_USING_UART
            config BSP_USING_UART1
                bool "Enable UART1"
                default y

            config BSP_UART1_RX_USING_DMA
                bool "Enable UART1 RX DMA"
                depends on BSP_USING_UART1 && RT_SERIAL_USING_DMA
                default n
        endif   
		
		if BSP_USING_UART
            config BSP_USING_UART2
                bool "Enable UART2"
                default y

            config BSP_UART2_RX_USING_DMA
                bool "Enable UART2 RX DMA"
                depends on BSP_USING_UART2 && RT_SERIAL_USING_DMA
                default n
        endif 
		


		

    source "../libraries/HAL_Drivers/Kconfig"
      
endmenu

menu "Board extended module Drivers"

endmenu

endmenu
```
